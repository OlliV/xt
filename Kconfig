## Kconfig
```kconfig
mainmenu "xt - terminal config"

config configGD
    bool
    default n

config configGLIB
    bool
    default n

menu "Appearance"

config configFONT
    string "Font"
    default "DejaVu Sans Mono:pixelsize=12:antialias=true:autohint=true"
    ---help---
     see http://freedesktop.org/software/fontconfig/fontconfig-user.html

config configBORDERPX
    int "Border pixels"
    default 2

config configWORDDELIMITERS
    string "Word delimiter string"
    default " "
    ---help---
    More advanced example: " `'\"()[]{}

config configDOUBLECLICKTIMEOUT
    int "Double click timeout [ms]"
    default 300

config configTRIPLECLICKTIMEOUT
    int "Triple click timeout [ms]"
    default 600

config configHIDE_X_CURSOR
    bool "Hide X cursor when typing"
    default y
    ---help---
    Hide the X cursor when typing in the terminal. The cursor is displayed again
    when the mouse is moved.

config configALLOWALTSCREEN
    bool "Alt screens"
    default y

config configXFPS
    int "X FPS"
    default 120

config configACTIONFPS
    int "AFPS"
    default 30

config configBLINKTIMEOUT
    int "Blinking timeout"
    default 800
    ---help---
    Blinking timeout (set to 0 to disable blinking) for the terminal blinking
    attribute.

config configBELLVOLUME
    int "Bell volume"
    default 1
    ---help---
    Bell volume value must be a value between -100 and 100. Use 0 for disabling
    it.

config configTABSPACES
    int "Tab spaces"
    default 8

menu "Terminal Colors"

config configCBLACK
    string "0: black"
    default "#2e3436"

config configCRED
    string "1: red"
    default "#cc0000"

config configCGREEN
    string "2: green"
    default "#4e9a06"

config configCYELLOW
    string "3: yellow"
    default "#c4a000"

config configCBLUE
    string "4: blue"
    default "#3465a4"

config configCMAGENTA
    string "5: magenta"
    default "#75507b"

config configCCYAN
    string "6: cyan"
    default "#06989a"

config configCWHITE
    string "7: white"
    default "#d3d7cf"

config configCBRBLACK
    string "8: brblack"
    default "#555753"

config configCBRRED
    string "9: brred"
    default "#ef2929"

config configCBRGREEN
    string "10: brgreen"
    default "#8ae234"

config configCBRYELLOW
    string "11: bryellow"
    default "#fce94f"

config configCBRBLUE
    string "12: brblue"
    default "#729fcf"

config configCBRMAGENTA
    string "13: brmagenta"
    default "#ad7fa8"

config configCBRCYAN
    string "14: brcyan"
    default "#34e2e2"

config configCBRWHITE
    string "15: brwhite"
    default "#eeeeec"

comment "Default colors (colorname index)"

config configCDEFAULTFG
    int "Default foreground"
    default 12

config configCDEFAULTBG
    int "Default background"
    default 8

config configCDEFAULTCS
    int "Default cursor"
    default 14

comment "Colors used, when the specific fg == defaultfg."

config configCDEFAULTITALIC
    int "Default italic"
    default 11

config configCDEFAULTUNDERLINE
    int "Default underline"
    default 7

endmenu

endmenu

config configTERMNAME
    string "TERM value"
    default "st-256color"

config configSHELL
    string "Shell"
    default "/bin/sh"

config configICON
    bool "Icon support"
    select configGD
    select configGLIB

config configICON_FILE
    string "Icon filename"
    depends on configICON
```
